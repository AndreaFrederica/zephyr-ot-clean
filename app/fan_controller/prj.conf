## CMakeLists.txt
```
# SPDX-License-Identifier: Apache-2.0

cmake_minimum_required(VERSION 3.20.0)

find_package(Zephyr REQUIRED HINTS $ENV{ZEPHYR_BASE})
project(esp32s3_fan_controller)

set(GENERATED_WEB_DIR ${CMAKE_CURRENT_BINARY_DIR}/generated)
set(GENERATED_WEB_HEADER ${GENERATED_WEB_DIR}/generated/web_assets.hpp)
set(GENERATED_WEB_SOURCE ${GENERATED_WEB_DIR}/generated/web_assets.cpp)
set(GENERATED_CURVE_HEADER ${GENERATED_WEB_DIR}/generated/default_curve_assets.hpp)
set(GENERATED_CURVE_SOURCE ${GENERATED_WEB_DIR}/generated/default_curve_assets.cpp)
set(GENERATED_CONFIG_HEADER ${GENERATED_WEB_DIR}/generated/config_assets.hpp)
set(GENERATED_CONFIG_SOURCE ${GENERATED_WEB_DIR}/generated/config_assets.cpp)

add_custom_command(
  OUTPUT ${GENERATED_WEB_HEADER} ${GENERATED_WEB_SOURCE}
  COMMAND ${Python3_EXECUTABLE}
          ${CMAKE_CURRENT_SOURCE_DIR}/scripts/generate_web_assets.py
          ${GENERATED_WEB_HEADER}
          ${GENERATED_WEB_SOURCE}
          ${CMAKE_CURRENT_SOURCE_DIR}/web/index.html web_asset_index_html
          ${CMAKE_CURRENT_SOURCE_DIR}/web/app.js web_asset_app_js
          ${CMAKE_CURRENT_SOURCE_DIR}/web/styles.css web_asset_styles_css
  DEPENDS
          ${CMAKE_CURRENT_SOURCE_DIR}/scripts/generate_web_assets.py
          ${CMAKE_CURRENT_SOURCE_DIR}/web/index.html
          ${CMAKE_CURRENT_SOURCE_DIR}/web/app.js
          ${CMAKE_CURRENT_SOURCE_DIR}/web/styles.css
  VERBATIM
)

add_custom_command(
  OUTPUT ${GENERATED_CURVE_HEADER} ${GENERATED_CURVE_SOURCE}
  COMMAND ${Python3_EXECUTABLE}
          ${CMAKE_CURRENT_SOURCE_DIR}/scripts/generate_default_curve_assets.py
          ${GENERATED_CURVE_HEADER}
          ${GENERATED_CURVE_SOURCE}
          ${CMAKE_CURRENT_SOURCE_DIR}/config/curves/adc_to_voltage.json curve_asset_adc_to_voltage
          ${CMAKE_CURRENT_SOURCE_DIR}/config/curves/voltage_to_percent.json curve_asset_voltage_to_percent
          ${CMAKE_CURRENT_SOURCE_DIR}/config/curves/percent_to_pwm.json curve_asset_percent_to_pwm
          ${CMAKE_CURRENT_SOURCE_DIR}/config/curves/percent_to_rpm.json curve_asset_percent_to_rpm
  DEPENDS
          ${CMAKE_CURRENT_SOURCE_DIR}/scripts/generate_default_curve_assets.py
          ${CMAKE_CURRENT_SOURCE_DIR}/config/curves/adc_to_voltage.json
          ${CMAKE_CURRENT_SOURCE_DIR}/config/curves/voltage_to_percent.json
          ${CMAKE_CURRENT_SOURCE_DIR}/config/curves/percent_to_pwm.json
          ${CMAKE_CURRENT_SOURCE_DIR}/config/curves/percent_to_rpm.json
  VERBATIM
)

add_custom_command(
  OUTPUT ${GENERATED_CONFIG_HEADER} ${GENERATED_CONFIG_SOURCE}
  COMMAND ${Python3_EXECUTABLE}
          ${CMAKE_CURRENT_SOURCE_DIR}/scripts/generate_config_assets.py
          ${GENERATED_CONFIG_HEADER}
          ${GENERATED_CONFIG_SOURCE}
          ${CMAKE_CURRENT_SOURCE_DIR}/config/config.json config_asset_config_json
          ${CMAKE_CURRENT_SOURCE_DIR}/config/wifi.json config_asset_wifi_json
          ${CMAKE_CURRENT_SOURCE_DIR}/config/ntp.json config_asset_ntp_json
  DEPENDS
          ${CMAKE_CURRENT_SOURCE_DIR}/scripts/generate_config_assets.py
          ${CMAKE_CURRENT_SOURCE_DIR}/config/config.json
          ${CMAKE_CURRENT_SOURCE_DIR}/config/wifi.json
          ${CMAKE_CURRENT_SOURCE_DIR}/config/ntp.json
  VERBATIM
)

target_sources(app PRIVATE
  src/main.cpp
  src/core/memory_domains.cpp
        src/core/fatal_reboot.cpp
  src/cli/cli_runtime.cpp
  src/cli/shell_commands.cpp
  src/cli/line_editor.cpp
  src/cli/kilo_editor.cpp
  src/cli/htop_monitor.cpp
  src/cli/command_session.cpp
  src/services/fan/curve_profiles.cpp
  src/services/storage/settings_store.cpp
  src/services/fan/fan_shared_state.cpp
  src/services/fan/fan_controller.cpp
  src/services/network/wifi_manager.cpp
  src/services/network/http/http_common.cpp
  src/services/network/http/http_api.cpp
  src/services/network/http/http_server.cpp
  src/services/ssh/ssh_server.cpp
  src/services/storage/storage.cpp
  src/services/host_control/host_control_manager.cpp
  ${GENERATED_WEB_SOURCE}
  ${GENERATED_CURVE_SOURCE}
  ${GENERATED_CONFIG_SOURCE}
)

target_include_directories(app PRIVATE
  src
  src/core
  src/cli
  src/services
  src/services/fan
  src/services/network
  src/services/network/http
  src/services/storage
  src/services/ssh
  src/services/host_control
  ${GENERATED_WEB_DIR}
)
```

## prj.conf
```kconfig
# ============================================
# ESP32-S3 Fan Controller - Zephyr Configuration
# Board: ESP32-S3-WROOM-N16R8 (8MB PSRAM, 320KB SRAM)
# ============================================

# --------------------------------------------
# Basic System
# --------------------------------------------
CONFIG_CONSOLE=y
CONFIG_PRINTK=y
CONFIG_SERIAL=y
CONFIG_UART_CONSOLE=y
CONFIG_CPP=y
CONFIG_REBOOT=y

# --------------------------------------------
# Hardware Peripherals
# --------------------------------------------
CONFIG_GPIO=y
CONFIG_PWM=y
CONFIG_ADC=y
CONFIG_FLASH=y
CONFIG_FLASH_MAP=y

# --------------------------------------------
# PSRAM Configuration (8MB External RAM)
# Revert to the last known-good shape first.
# --------------------------------------------
CONFIG_ESP_SPIRAM=y
CONFIG_ESP_SPIRAM_HEAP_SIZE=4194304
CONFIG_SPIRAM_MODE_OCT=y

# --------------------------------------------
# Network Stack (Buffers in PSRAM via noinit section)
# Total PSRAM usage: ~100KB
#   - RX: 24 x 1800 = 43KB
#   - TX: 24 x 1800 = 43KB
#   - PKT: minimal (in DRAM)
# --------------------------------------------
CONFIG_NETWORKING=y
CONFIG_NET_L2_ETHERNET=y
CONFIG_NET_L2_WIFI_MGMT=y
CONFIG_NET_MGMT=y
CONFIG_NET_MGMT_EVENT=y
CONFIG_NET_MGMT_EVENT_INFO=y
CONFIG_NET_IPV4=y
CONFIG_NET_TCP=y
CONFIG_NET_UDP=y
CONFIG_NET_SOCKETS=y
CONFIG_NET_CONNECTION_MANAGER=y
CONFIG_NET_CONFIG_AUTO_INIT=n
CONFIG_NET_DHCPV4=y
CONFIG_NET_DHCPV4_SERVER=y
CONFIG_NET_DHCPV4_OPTION_NTP_SERVER=y
CONFIG_SNTP=y

# Network interfaces
CONFIG_NET_IF_MAX_IPV4_COUNT=2
CONFIG_NET_IF_MAX_IPV6_COUNT=1

# Packet buffers (small, in DRAM) - reduced to save memory

CONFIG_NET_PKT_RX_COUNT=16
CONFIG_NET_PKT_TX_COUNT=16
CONFIG_NET_BUF_RX_COUNT=32
CONFIG_NET_BUF_TX_COUNT=32


# CONFIG_NET_PKT_RX_COUNT=24
# CONFIG_NET_PKT_TX_COUNT=24

# # Data buffers (large, moved to PSRAM via linker script)
# CONFIG_NET_BUF_RX_COUNT=64
# CONFIG_NET_BUF_TX_COUNT=64
# Support large packets
CONFIG_NET_BUF_DATA_SIZE=2048

# Network event handling (reduced stack sizes)
CONFIG_NET_MGMT_EVENT_QUEUE_SIZE=16
CONFIG_NET_MGMT_EVENT_STACK_SIZE=4096
CONFIG_NET_TX_STACK_SIZE=4096
CONFIG_NET_RX_STACK_SIZE=4096
CONFIG_NET_SOCKETS_SERVICE_STACK_SIZE=4096
CONFIG_NET_TCP_WORKQ_STACK_SIZE=3072

# --------------------------------------------
# WiFi Configuration (PSRAM enabled)
# --------------------------------------------
CONFIG_WIFI=y
CONFIG_WIFI_NM=y
CONFIG_WIFI_USAGE_MODE_STA_AP=y

# WiFi memory from PSRAM
CONFIG_ESP_WIFI_HEAP_SPIRAM=y
CONFIG_ESP32_WIFI_NET_ALLOC_SPIRAM=y

# Reduced WiFi buffers to free DRAM
# Static RX buffers (in DRAM)
CONFIG_ESP32_WIFI_STATIC_RX_BUFFER_NUM=16
# Dynamic RX buffers (in PSRAM)
CONFIG_ESP32_WIFI_DYNAMIC_RX_BUFFER_NUM=64
# TX buffers - keep static for stability
CONFIG_ESP32_WIFI_STATIC_TX_BUFFER=y
CONFIG_ESP32_WIFI_STATIC_TX_BUFFER_NUM=16
CONFIG_ESP32_WIFI_CACHE_TX_BUFFER_NUM=16

# --------------------------------------------
# File System (LittleFS on Flash)
# --------------------------------------------
CONFIG_FILE_SYSTEM=y
CONFIG_FILE_SYSTEM_LITTLEFS=y
CONFIG_SETTINGS=y
CONFIG_SETTINGS_FILE=y
CONFIG_SETTINGS_FILE_PATH="/lfs/var/lib/fanctl/settings.bin"
CONFIG_FS_LITTLEFS_CACHE_SIZE=512
CONFIG_FS_LITTLEFS_LOOKAHEAD_SIZE=128

# --------------------------------------------
# Shell
# --------------------------------------------
CONFIG_SHELL=y
CONFIG_SHELL_BACKEND_SERIAL=y
CONFIG_SHELL_CMD_BUFF_SIZE=256
CONFIG_SHELL_PROMPT_CHANGE=y
CONFIG_SHELL_PROMPT_BUFF_SIZE=40
CONFIG_KERNEL_SHELL=y
CONFIG_SHELL_TAB=y
CONFIG_SHELL_TAB_AUTOCOMPLETION=y
CONFIG_NET_L2_WIFI_SHELL=y
CONFIG_SHELL_STACK_SIZE=8192

# --------------------------------------------
# wolfSSH
# --------------------------------------------
CONFIG_POSIX_API=y
CONFIG_WOLFSSH=y
CONFIG_WOLFSSH_SETTINGS_FILE="wolfssh_user_settings.h"

# --------------------------------------------
# Logging
# --------------------------------------------
CONFIG_LOG=y
CONFIG_LOG_MODE_DEFERRED=y
CONFIG_LOG_DEFAULT_LEVEL=3
CONFIG_LOG_PROCESS_THREAD_STACK_SIZE=4096
CONFIG_SYS_HEAP_RUNTIME_STATS=y
CONFIG_CBPRINTF_FP_SUPPORT=y
CONFIG_PICOLIBC_IO_FLOAT=y

# --------------------------------------------
# Memory Configuration (Internal DRAM: ~320KB)
# Layout after optimization:
#   - Stacks: ~70KB (reduced from ~80KB)
#   - BSS/Data: ~60KB (reduced WiFi buffers)
#   - Heap: 153KB (increased for dynamic WiFi stacks + app use)
#   - Network noinit: moved to PSRAM
# --------------------------------------------

# SEPARATE HEAPS - Adjusted for available DRAM
# Kernel heap: for Zephyr kernel internal objects (system minimum ~28KB)
CONFIG_HEAP_MEM_POOL_SIZE=92160

# Libc heap: for application AND WiFi driver (~100KB)
# Total DRAM usage: ~28KB + ~100KB + stacks + BSS = ~200KB of ~320KB
# CONFIG_COMMON_LIBC_MALLOC_ARENA_SIZE=81920

# Optimized stack sizes
CONFIG_MAIN_STACK_SIZE=8192
CONFIG_SYSTEM_WORKQUEUE_STACK_SIZE=5120
CONFIG_IDLE_STACK_SIZE=1024
CONFIG_INIT_STACKS=y
CONFIG_THREAD_STACK_INFO=y
CONFIG_STACK_SENTINEL=y

# WiFi task stacks are now dynamically allocated from heap
# (see esp_wifi_adapter_patch.c)
```

## src/main.cpp
```c
/*
 * SPDX-License-Identifier: Apache-2.0
 */

#include <zephyr/kernel.h>
#include <zephyr/logging/log.h>
#include <zephyr/sys/printk.h>

#include "core/common.hpp"
#include "curve_profiles.hpp"
#include "fan_controller.hpp"
#include "host_control_manager.hpp"
#include "http_server.hpp"
#include "memory_domains.hpp"
#include "settings_store.hpp"
#include "core/service_context.hpp"
#include "shell_commands.hpp"
#include "ssh_server.hpp"
#include "storage.hpp"
#include "wifi_manager.hpp"

LOG_MODULE_REGISTER(fanctl_app, LOG_LEVEL_INF);

// 全局对象（用于跨模块访问）
namespace fanctl {
	FanController g_fan_controller;
	HostControlManager g_host_control(g_fan_controller.GetSharedState(), &g_fan_controller);
	WifiManager g_wifi_manager;
}

// 让 main 函数可以方便访问
using fanctl::g_fan_controller;
using fanctl::g_wifi_manager;
using fanctl::g_host_control;

// 检查共享内存状态有效
static_assert(sizeof(fanctl::FanControllerSharedState) < 1024, "Shared state too large");

namespace {

fanctl::ServiceContext g_services = { &g_fan_controller, &g_wifi_manager, &g_host_control };
fanctl::HttpServer g_http_server(g_services);
fanctl::SshServer g_ssh_server(g_services);

// 状态同步线程 (10Hz - 将 WiFi 状态同步到控制循环)
K_THREAD_STACK_DEFINE(g_status_sync_stack, fanctl::kStatusSyncStackSize);
struct k_thread g_status_sync_thread;

// 静态存储区 - 避免栈溢出
static fanctl::WifiSnapshot g_wifi_snapshot;
static fanctl::HostControlSnapshot g_host_snapshot;

void StatusSyncThread(void *, void *, void *)
{
	while (true) {
		// 使用静态存储，避免栈上分配大结构
		g_wifi_manager.RefreshRuntimeStatus();
		g_wifi_manager.GetSnapshot(&g_wifi_snapshot);
		
		// 同步 WiFi 状态到控制循环 (通过原子变量)
		g_fan_controller.SetWifiStatus(g_wifi_snapshot.sta_connected, 
						       g_wifi_snapshot.ap_enabled);
		
		// 主机控制心跳检测
		g_host_control.Tick();
		
		// 可选：更新主机控制快照供外部查询
		g_host_control.GetSnapshot(&g_host_snapshot);
		
		k_sleep(K_MSEC(200));  // 5Hz 降低频率减少栈压力
	}
}

} // namespace

int main()
{
	g_fan_controller.InitRuntime();

	int rc = fanctl::storage::Init();
	if (rc != 0) {
		LOG_ERR("storage init failed: %d", rc);
		return rc;
	}

	rc = fanctl::settings::Init();
	if (rc != 0) {
		LOG_ERR("settings init failed: %d", rc);
		return rc;
	}

	g_fan_controller.LoadPersistedState();

	rc = g_fan_controller.InitHardware();
	if (rc != 0) {
		LOG_ERR("fan controller init failed: %d", rc);
		return rc;
	}

	rc = fanctl::g_wifi_manager.Init();
	if (rc != 0) {
		LOG_ERR("wifi manager init failed: %d", rc);
		return rc;
	}

	rc = fanctl::g_host_control.Init();
	if (rc != 0) {
		LOG_ERR("host control init failed: %d", rc);
		return rc;
	}

	fanctl::memory::Init();

	rc = g_ssh_server.Init();
	if (rc != 0) {
		LOG_ERR("ssh server init failed: %d", rc);
		return rc;
	}

	fanctl::shell_commands::Init(g_services);

	// 启动 100Hz 控制循环
	g_fan_controller.StartControlLoop();

	// 启动状态同步线程
	k_thread_create(&g_status_sync_thread, g_status_sync_stack,
			K_THREAD_STACK_SIZEOF(g_status_sync_stack), StatusSyncThread, nullptr, nullptr,
			nullptr, 6, 0, K_NO_WAIT);
	k_thread_name_set(&g_status_sync_thread, "fanctl_sync");

	g_http_server.Start();
	g_ssh_server.Start();

	fanctl::WifiSnapshot wifi = {};
	g_wifi_manager.GetSnapshot(&wifi);

	printk("Fan controller ready (100Hz control loop).\n");
	
	// Show AP or STA info based on what's enabled
	if (wifi.ap_enabled) {
		printk("AP SSID: %s  PSK: %s  IP: %s\n", 
		       wifi.ap_ssid[0] != '\0' ? wifi.ap_ssid : "(starting)", 
		       fanctl::kApPsk, fanctl::kApIpAddr);
	}
	
	if (wifi.sta_connected) {
		printk("STA IP: %s  (connected to: %s)\n", wifi.sta_ip, wifi.saved_ssid);
	} else if (wifi.saved_ssid[0] != '\0') {
		printk("STA: Connecting to %s...\n", wifi.saved_ssid);
	}
	
	// HTTP server listens on all interfaces
	if (wifi.ap_enabled && wifi.sta_connected) {
		printk("HTTP: http://%s/  http://%s/\n", fanctl::kApIpAddr, wifi.sta_ip);
	} else if (wifi.sta_connected) {
		printk("HTTP: http://%s/\n", wifi.sta_ip);
	} else if (wifi.ap_enabled) {
		printk("HTTP: http://%s/\n", fanctl::kApIpAddr);
	}
	
	printk("Shell: fanctl status\n");
	printk("Config: %s\n", fanctl::settings::GetConfigRelativePath());
	printk("Curves: %s  %s  %s  %s\n", fanctl::curves::CurveProfiles::GetAdcToVoltagePath(),
	       fanctl::curves::CurveProfiles::GetVoltageToPercentPath(),
	       fanctl::curves::CurveProfiles::GetPercentToPwmPath(),
	       fanctl::curves::CurveProfiles::GetPercentToRpmPath());
	printk("SSH Config: %s\n", fanctl::settings::GetSshConfigRelativePath());
	printk("Authorized Keys: %s\n", fanctl::settings::GetAuthorizedKeysRelativePath());
	if (g_ssh_server.IsEnabled()) {
		const char *ssh_ip = wifi.sta_connected ? wifi.sta_ip : fanctl::kApIpAddr;
		printk("SSH: ssh root@%s -p %d\n", ssh_ip, g_ssh_server.GetListenPort());
	}

	while (true) {
		k_sleep(K_SECONDS(60));
	}
}
```

## src/command_session.hpp
```c
/*
 * SPDX-License-Identifier: Apache-2.0
 */

#ifndef FAN_CONTROLLER_COMMAND_SESSION_HPP_
#define FAN_CONTROLLER_COMMAND_SESSION_HPP_

#include <stddef.h>

#include "fan_controller.hpp"
#include "host_control_manager.hpp"
#include "line_editor.hpp"
#include "wifi_manager.hpp"

namespace fanctl {

using SessionWriteFn = void (*)(void *ctx, const char *text, size_t len);

struct CommandSessionResult {
	bool exit_requested;
	bool reboot_requested;
};

class CommandSession {
public:
	CommandSession(FanController &fan_controller, WifiManager &wifi_manager,
		       HostControlManager &host_control);

	void Reset();
	void BuildPrompt(char *buffer, size_t buffer_len) const;
	int Execute(const char *command_line, SessionWriteFn writer, void *ctx,
		    CommandSessionResult *result);
	int Complete(const char *command_line, SessionWriteFn writer, void *ctx,
		     char *completion, size_t completion_len);

private:
	void Emit(SessionWriteFn writer, void *ctx, const char *text) const;
	void Emitf(SessionWriteFn writer, void *ctx, const char *fmt, ...) const;
	int ResolvePath(const char *input, char *output, size_t output_len) const;
	int Tokenize(char *line, char *argv[], size_t argv_len) const;
	int JoinTokens(char *buffer, size_t buffer_len, char *argv[], int argc, int start) const;
	int ApplyConfigFromStore() const;
	int HandleFanctl(char *argv[], int argc, SessionWriteFn writer, void *ctx);
	int HandleShow(char *argv[], int argc, SessionWriteFn writer, void *ctx) const;
	int HandleEdit(char *argv[], int argc, SessionWriteFn writer, void *ctx);
	int HandleLs(const char *path, SessionWriteFn writer, void *ctx) const;
	int HandleCat(const char *path, SessionWriteFn writer, void *ctx) const;
	int HandleMkdir(const char *path, SessionWriteFn writer, void *ctx) const;
	int HandleRm(const char *path, SessionWriteFn writer, void *ctx) const;
	int HandleTouch(const char *path, SessionWriteFn writer, void *ctx) const;
	int HandleWriteFile(char *argv[], int argc, SessionWriteFn writer, void *ctx);
	void EmitHelp(SessionWriteFn writer, void *ctx) const;

	FanController &fan_controller_;
	WifiManager &wifi_manager_;
	HostControlManager &host_control_;
	LineEditor editor_;
	char cwd_[128];
};

} // namespace fanctl

#endif
```

## src/common.hpp
```c
/*
 * SPDX-License-Identifier: Apache-2.0
 */

#ifndef FAN_CONTROLLER_COMMON_HPP_
#define FAN_CONTROLLER_COMMON_HPP_

#include <stddef.h>
#include <stdint.h>
#include <zephyr/net/wifi.h>

namespace fanctl {

constexpr size_t kFanCount = 2;
constexpr int kHttpPort = 80;
constexpr int kHttpStackSize = 16384;
constexpr int kSshStackSize = 24576;
constexpr int kTelemetryStackSize = 4096;
constexpr const char *kApIpAddr = "192.168.4.1";
constexpr const char *kApNetmask = "255.255.255.0";
constexpr const char *kApPsk = "fancontrol123";
constexpr const char *kDeviceHostname = "fanctl";

struct FanState {
	bool enabled;
	bool use_adc_target;
	uint8_t percent;
	uint8_t effective_percent;
	uint8_t pwm_percent;
	uint8_t adc_target_percent;
	uint8_t actual_percent;
	int32_t adc_raw;
	int32_t adc_mv;
	int32_t mapped_voltage_mv;
	int32_t actual_rpm;
	int32_t target_rpm;
	uint32_t pwm_pulse_ns;
	bool tach_valid;
};

struct WifiSnapshot {
	bool ap_enabled;
	int ap_clients;
	bool sta_connected;
	char ap_ssid[WIFI_SSID_MAX_LEN + 1];
	char saved_ssid[WIFI_SSID_MAX_LEN + 1];
	char sta_state[24];
	int sta_rssi;
};

struct HostControlSnapshot {
	bool alive_check_enabled;
	bool timed_out;
	uint32_t timeout_ms;
	uint32_t last_alive_ago_ms;
};

struct WifiScanResult {
	char ssid[WIFI_SSID_MAX_LEN + 1];
	uint8_t bssid[6];
	int8_t rssi;
	uint8_t channel;
	enum wifi_security_type security;
	bool valid;
};

} // namespace fanctl

#endif
```

## src/curve_profiles.cpp
```c
/*
 * SPDX-License-Identifier: Apache-2.0
 */

#include "curve_profiles.hpp"

#include <ctype.h>
#include <errno.h>
#include <stdlib.h>
#include <string.h>

#include <zephyr/sys/util.h>

#include "generated/default_curve_assets.hpp"
#include "storage.hpp"

namespace fanctl::curves {

namespace {

constexpr const char *kAdcToVoltagePath = "/etc/fanctl/curves/adc_to_voltage.json";
constexpr const char *kVoltageToPercentPath = "/etc/fanctl/curves/voltage_to_percent.json";
constexpr const char *kPercentToPwmPath = "/etc/fanctl/curves/percent_to_pwm.json";
constexpr const char *kPercentToRpmPath = "/etc/fanctl/curves/percent_to_rpm.json";

void SkipWhitespace(const char **cursor)
{
	while (**cursor != '\0' && isspace(static_cast<unsigned char>(**cursor)) != 0) {
		++(*cursor);
	}
}

bool SeekChar(const char **cursor, char needle)
{
	while (**cursor != '\0') {
		if (**cursor == needle) {
			return true;
		}
		++(*cursor);
	}

	return false;
}

bool ParseInt(const char **cursor, int *value)
{
	SkipWhitespace(cursor);

	char *end = nullptr;
	long parsed = strtol(*cursor, &end, 10);
	if (end == *cursor) {
		return false;
	}

	*value = static_cast<int>(parsed);
	*cursor = end;
	return true;
}

bool ParsePointPairs(const char *json, CurveProfiles::CurveData *curve)
{
	const char *points = strstr(json, "\"points\"");
	if (points == nullptr || curve == nullptr) {
		return false;
	}

	const char *cursor = strchr(points, '[');
	if (cursor == nullptr) {
		return false;
	}

	cursor++;
	curve->point_count = 0U;

	while (*cursor != '\0') {
		SkipWhitespace(&cursor);
		if (*cursor == ']') {
			break;
		}

		if (*cursor != '[') {
			++cursor;
			continue;
		}

		++cursor;
		if (curve->point_count >= ARRAY_SIZE(curve->points)) {
			return false;
		}

		CurvePoint point = {};
		if (!ParseInt(&cursor, &point.x)) {
			return false;
		}

		if (!SeekChar(&cursor, ',')) {
			return false;
		}
		++cursor;

		if (!ParseInt(&cursor, &point.y)) {
			return false;
		}

		if (!SeekChar(&cursor, ']')) {
			return false;
		}
		++cursor;

		curve->points[curve->point_count++] = point;
	}

	return curve->point_count >= 2U;
}

} // namespace

CurveProfiles::CurveProfiles()
	: adc_to_voltage_{}, voltage_to_percent_{}, percent_to_pwm_{}, percent_to_rpm_{}
{
}

int CurveProfiles::EnsureDefaultFiles() const
{
	for (size_t i = 0; i < kDefaultCurveAssetCount; ++i) {
		if (storage::PathExists(kDefaultCurveAssets[i].path)) {
			continue;
		}

		int rc = storage::WriteTextFile(kDefaultCurveAssets[i].path,
						reinterpret_cast<const char *>(kDefaultCurveAssets[i].data),
						kDefaultCurveAssets[i].size);
		if (rc != 0) {
			return rc;
		}
	}

	return 0;
}

int CurveProfiles::LoadCurveFile(const char *path, CurveData *curve) const
{
	char json[768];
	size_t json_len = 0U;
	int rc = storage::ReadTextFile(path, json, sizeof(json), &json_len);
	if (rc != 0) {
		return rc;
	}

	return ParsePointPairs(json, curve) ? 0 : -EINVAL;
}

int CurveProfiles::Init()
{
	int rc = EnsureDefaultFiles();
	if (rc != 0) {
		return rc;
	}

	rc = LoadCurveFile(kAdcToVoltagePath, &adc_to_voltage_);
	if (rc != 0) {
		return rc;
	}

	rc = LoadCurveFile(kVoltageToPercentPath, &voltage_to_percent_);
	if (rc != 0) {
		return rc;
	}

	rc = LoadCurveFile(kPercentToPwmPath, &percent_to_pwm_);
	if (rc != 0) {
		return rc;
	}

	return LoadCurveFile(kPercentToRpmPath, &percent_to_rpm_);
}

int CurveProfiles::EvaluateCurve(const CurveData &curve, int input)
{
	if (curve.point_count == 0U) {
		return 0;
	}

	if (input <= curve.points[0].x) {
		return curve.points[0].y;
	}

	for (size_t i = 1U; i < curve.point_count; ++i) {
		if (input <= curve.points[i].x) {
			const CurvePoint &a = curve.points[i - 1U];
			const CurvePoint &b = curve.points[i];
			const int dx = b.x - a.x;
			if (dx <= 0) {
				return b.y;
			}

			const int64_t dy = static_cast<int64_t>(b.y - a.y);
			const int64_t nx = static_cast<int64_t>(input - a.x);
			return a.y + static_cast<int>((dy * nx) / dx);
		}
	}

	return curve.points[curve.point_count - 1U].y;
}

int CurveProfiles::EvaluateCurveInverse(const CurveData &curve, int output)
{
	if (curve.point_count == 0U) {
		return 0;
	}

	if (output <= curve.points[0].y) {
		return curve.points[0].x;
	}

	for (size_t i = 1U; i < curve.point_count; ++i) {
		if (output <= curve.points[i].y) {
			const CurvePoint &a = curve.points[i - 1U];
			const CurvePoint &b = curve.points[i];
			const int dy = b.y - a.y;
			if (dy <= 0) {
				return b.x;
			}

			const int64_t dx = static_cast<int64_t>(b.x - a.x);
			const int64_t ny = static_cast<int64_t>(output - a.y);
			return a.x + static_cast<int>((dx * ny) / dy);
		}
	}

	return curve.points[curve.point_count - 1U].x;
}

int32_t CurveProfiles::EvaluateAdcRawToVoltage(int32_t adc_raw) const
{
	return EvaluateCurve(adc_to_voltage_, adc_raw);
}

uint8_t CurveProfiles::EvaluateVoltageToPercent(int32_t voltage_mv) const
{
	return static_cast<uint8_t>(CLAMP(EvaluateCurve(voltage_to_percent_, voltage_mv), 0, 100));
}

uint8_t CurveProfiles::EvaluateAdcRawToPercent(int32_t adc_raw) const
{
	return EvaluateVoltageToPercent(EvaluateAdcRawToVoltage(adc_raw));
}

uint8_t CurveProfiles::EvaluatePercentToPwm(uint8_t percent) const
{
	return static_cast<uint8_t>(CLAMP(EvaluateCurve(percent_to_pwm_, percent), 0, 100));
}

int32_t CurveProfiles::EvaluatePercentToRpm(uint8_t percent) const
{
	return EvaluateCurve(percent_to_rpm_, percent);
}

uint8_t CurveProfiles::EvaluateRpmToPercent(int32_t rpm) const
{
	return static_cast<uint8_t>(CLAMP(EvaluateCurveInverse(percent_to_rpm_, rpm), 0, 100));
}

const char *CurveProfiles::GetAdcToVoltagePath()
{
	return kAdcToVoltagePath;
}

const char *CurveProfiles::GetVoltageToPercentPath()
{
	return kVoltageToPercentPath;
}

const char *CurveProfiles::GetPercentToPwmPath()
{
	return kPercentToPwmPath;
}

const char *CurveProfiles::GetPercentToRpmPath()
{
	return kPercentToRpmPath;
}

} // namespace fanctl::curves
```

## src/curve_profiles.hpp
```c
/*
 * SPDX-License-Identifier: Apache-2.0
 */

#ifndef FAN_CONTROLLER_CURVE_PROFILES_HPP_
#define FAN_CONTROLLER_CURVE_PROFILES_HPP_

#include <stddef.h>
#include <stdint.h>

namespace fanctl::curves {

struct CurvePoint {
	int x;
	int y;
};

class CurveProfiles {
public:
	struct CurveData {
		CurvePoint points[16];
		size_t point_count;
	};

	CurveProfiles();

	int Init();
	int32_t EvaluateAdcRawToVoltage(int32_t adc_raw) const;
	uint8_t EvaluateVoltageToPercent(int32_t voltage_mv) const;
	uint8_t EvaluateAdcRawToPercent(int32_t adc_raw) const;
	uint8_t EvaluatePercentToPwm(uint8_t percent) const;
	int32_t EvaluatePercentToRpm(uint8_t percent) const;
	uint8_t EvaluateRpmToPercent(int32_t rpm) const;

	static const char *GetAdcToVoltagePath();
	static const char *GetVoltageToPercentPath();
	static const char *GetPercentToPwmPath();
	static const char *GetPercentToRpmPath();

private:
	int EnsureDefaultFiles() const;
	int LoadCurveFile(const char *path, CurveData *curve) const;
	static int EvaluateCurve(const CurveData &curve, int input);
	static int EvaluateCurveInverse(const CurveData &curve, int output);

	CurveData adc_to_voltage_;
	CurveData voltage_to_percent_;
	CurveData percent_to_pwm_;
	CurveData percent_to_rpm_;
};

} // namespace fanctl::curves

#endif
```

## src/fan_controller.hpp
```c
/*
 * SPDX-License-Identifier: Apache-2.0
 */

#ifndef FAN_CONTROLLER_FAN_CONTROLLER_HPP_
#define FAN_CONTROLLER_FAN_CONTROLLER_HPP_

#include <zephyr/drivers/adc.h>
#include <zephyr/drivers/adc/voltage_divider.h>
#include <zephyr/drivers/gpio.h>
#include <zephyr/drivers/pwm.h>
#include <zephyr/kernel.h>
#include <zephyr/sys/atomic.h>

#include "common.hpp"
#include "curve_profiles.hpp"

namespace fanctl {

class FanController {
public:
	FanController();

	void InitRuntime();
	int Init();
	void LoadPersistedState();
	int SetFan(size_t index, uint8_t percent, bool enabled, bool persist);
	int SetAdcTargetMode(size_t index, bool use_adc_target, bool persist);
	int ConfigureFan(size_t index, uint8_t percent, bool enabled, bool use_adc_target, bool persist);
	int ConfigureFanTargetRpm(size_t index, int32_t target_rpm, bool enabled, bool persist);
	void UpdateTelemetry(bool sta_connected, bool ap_enabled);
	void GetState(size_t index, FanState *state);
	void GetAllStates(FanState states[kFanCount]);
	const curves::CurveProfiles &GetCurves() const;

private:
	struct Channel {
		const char *name;
		struct pwm_dt_spec pwm;
		struct gpio_dt_spec power;
		struct voltage_divider_dt_spec sense;
		struct gpio_dt_spec tach;
		struct gpio_callback tach_cb;
		bool enabled;
		bool use_adc_target;
		uint8_t percent;
		uint8_t effective_percent;
		uint8_t pwm_percent;
		uint8_t adc_target_percent;
		uint8_t actual_percent;
		int32_t adc_raw;
		int32_t adc_mv;
		int32_t mapped_voltage_mv;
		int32_t actual_rpm;
		int32_t target_rpm;
		uint32_t pwm_pulse_ns;
		atomic_t tach_edges;
		uint32_t last_tach_edges;
	};

	static void TachCallback(const struct device *port, struct gpio_callback *cb, gpio_port_pins_t pins);
	int ApplyLocked(size_t index);
	int ReadSenseLocked(size_t index, int32_t *raw, int32_t *mv);
	void UpdateDerivedStateLocked(size_t index);
	void UpdateStatusLedLocked(bool sta_connected, bool ap_enabled);

	Channel fans_[kFanCount];
	struct gpio_dt_spec status_led_;
	curves::CurveProfiles curves_;
	struct k_mutex mutex_;
	bool blink_phase_;
	int64_t last_sample_ms_;
};

} // namespace fanctl

#endif
```

## src/host_control_manager.cpp
```c
/*
 * SPDX-License-Identifier: Apache-2.0
 */

#include "host_control_manager.hpp"

#include <zephyr/sys/util.h>

namespace fanctl {

HostControlManager::HostControlManager(FanController &fan_controller)
	: fan_controller_(fan_controller), alive_check_enabled_(false), timed_out_(false),
	  timeout_ms_(5000U), last_alive_ms_(0)
{
}

int HostControlManager::Init()
{
	k_mutex_init(&mutex_);

	settings::AppConfig config = {};
	int rc = settings::LoadConfig(&config);
	if (rc != 0) {
		return rc;
	}

	Configure(config);
	return 0;
}

void HostControlManager::Configure(const settings::AppConfig &config)
{
	k_mutex_lock(&mutex_, K_FOREVER);
	alive_check_enabled_ = config.host_alive_check_enabled;
	timeout_ms_ = config.host_alive_timeout_ms;
	if (!alive_check_enabled_) {
		timed_out_ = false;
	}
	k_mutex_unlock(&mutex_);
}

void HostControlManager::MarkAlive()
{
	k_mutex_lock(&mutex_, K_FOREVER);
	last_alive_ms_ = k_uptime_get();
	timed_out_ = false;
	k_mutex_unlock(&mutex_);
}

void HostControlManager::Tick()
{
	k_mutex_lock(&mutex_, K_FOREVER);
	const bool enabled = alive_check_enabled_;
	const bool already_timed_out = timed_out_;
	const uint32_t timeout_ms = timeout_ms_;
	const int64_t last_alive_ms = last_alive_ms_;
	k_mutex_unlock(&mutex_);

	if (!enabled || already_timed_out) {
		return;
	}

	const int64_t now_ms = k_uptime_get();
	if (last_alive_ms == 0 || now_ms - last_alive_ms < static_cast<int64_t>(timeout_ms)) {
		return;
	}

	// 超时后将所有风扇PWM设为0（关闭风扇），但保持电源使能状态
	for (size_t i = 0; i < kFanCount; ++i) {
		FanState state = {};
		fan_controller_.GetState(i, &state);
		// 仅对非ADC模式的风扇应用超时保护
		if (state.enabled && !state.use_adc_target) {
			// 设置percent=0关闭风扇，但保持enabled=true
			(void)fan_controller_.ConfigureFan(i, 0, true, state.use_adc_target, false);
		}
	}

	k_mutex_lock(&mutex_, K_FOREVER);
	timed_out_ = true;
	k_mutex_unlock(&mutex_);
}

void HostControlManager::GetSnapshot(HostControlSnapshot *snapshot) const
{
	if (snapshot == nullptr) {
		return;
	}

	k_mutex_lock(const_cast<k_mutex *>(&mutex_), K_FOREVER);
	snapshot->alive_check_enabled = alive_check_enabled_;
	snapshot->timed_out = timed_out_;
	snapshot->timeout_ms = timeout_ms_;
	if (last_alive_ms_ <= 0) {
		snapshot->last_alive_ago_ms = 0U;
	} else {
		const int64_t delta = k_uptime_get() - last_alive_ms_;
		snapshot->last_alive_ago_ms = static_cast<uint32_t>(delta > 0 ? delta : 0);
	}
	k_mutex_unlock(const_cast<k_mutex *>(&mutex_));
}

} // namespace fanctl
```

## src/http_server.hpp
```c
/*
 * SPDX-License-Identifier: Apache-2.0
 */

#ifndef FAN_CONTROLLER_HTTP_SERVER_HPP_
#define FAN_CONTROLLER_HTTP_SERVER_HPP_

#include <zephyr/kernel.h>

#include "fan_controller.hpp"
#include "host_control_manager.hpp"
#include "wifi_manager.hpp"

namespace fanctl {

class HttpServer {
public:
	HttpServer(FanController &fan_controller, WifiManager &wifi_manager,
		   HostControlManager &host_control);

	void Start();

private:
	static void ThreadEntry(void *ctx, void *unused1, void *unused2);
	void Run();
	void HandleClient(int client);

	FanController &fan_controller_;
	WifiManager &wifi_manager_;
	HostControlManager &host_control_;
	struct k_thread thread_;
};

} // namespace fanctl

#endif
```

## src/settings_store.hpp
```c
/*
 * SPDX-License-Identifier: Apache-2.0
 */

#ifndef FAN_CONTROLLER_SETTINGS_STORE_HPP_
#define FAN_CONTROLLER_SETTINGS_STORE_HPP_

#include <stddef.h>
#include <stdint.h>

#include "common.hpp"

namespace fanctl::settings {

struct AppConfig {
	bool fan_enabled[kFanCount];
	uint8_t fan_percent[kFanCount];
	bool fan_use_adc_target[kFanCount];
	bool host_alive_check_enabled;
	uint32_t host_alive_timeout_ms;
};

struct SshConfig {
	bool enabled;
	int listen_port;
	char host_key_path[128];
	char username[32];
	char password[64];
	bool allow_password_auth;
	bool allow_public_key_auth;
	char authorized_keys_path[128];
};

struct NtpConfig {
	bool enabled;
	char server[64];
	int port;
	int sync_interval_hours;
};

struct WifiConfig {
	char sta_ssid[WIFI_SSID_MAX_LEN + 1];
	char sta_psk[WIFI_PSK_MAX_LEN + 1];
	bool ap_enabled;
	char ap_ssid_prefix[16];
	bool ap_ssid_use_mac_suffix;
	char ap_ssid_custom[33];
	int ap_channel;
	bool ap_hidden;
	int ap_max_clients;
	char dhcp_hostname[32];
	bool sta_auto_reconnect;
	int sta_scan_threshold;
};

int Init();
void GetDefaultConfig(AppConfig *config);
int LoadConfig(AppConfig *config);
int SaveConfig(const AppConfig *config);
int ReadConfigJson(char *json, size_t json_len, size_t *out_len);
int WriteConfigJson(const char *json, size_t json_len);
int LoadSshConfig(SshConfig *config);
int ReadSshConfigJson(char *json, size_t json_len, size_t *out_len);
int WriteSshConfigJson(const char *json, size_t json_len);
int LoadNtpConfig(NtpConfig *config);
int ReadNtpConfigJson(char *json, size_t json_len, size_t *out_len);
int WriteNtpConfigJson(const char *json, size_t json_len);
const char *GetNtpConfigRelativePath();

void FillWifiDefaults(WifiConfig *config);
int LoadWifiConfig(WifiConfig *config);
int ReadWifiConfigJson(char *json, size_t json_len, size_t *out_len);
int WriteWifiConfigJson(const char *json, size_t json_len);
const char *GetWifiConfigRelativePath();
void SaveWifiCredentials(const char *ssid, const char *psk);
void ClearWifiCredentials();
int LoadWifiCredentials(char *ssid, size_t ssid_len, char *psk, size_t psk_len);
const char *GetConfigRelativePath();
const char *GetFieldDefinitionsRelativePath();
const char *GetSshConfigRelativePath();
const char *GetAuthorizedKeysRelativePath();
int LoadFanState(size_t index, bool *enabled, uint8_t *percent);
void SaveFanState(size_t index, bool enabled, uint8_t percent);
int LoadFanAdcTargetMode(size_t index, bool *use_adc_target);
void SaveFanAdcTargetMode(size_t index, bool use_adc_target);
int SaveFanDefaults(size_t index, bool enabled, uint8_t percent, bool use_adc_target);

} // namespace fanctl::settings

#endif
```
