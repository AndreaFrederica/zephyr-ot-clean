## boards/espressif/esp32s3_fan_controller/Kconfig.esp32s3_fan_controller
```kconfig
# Copyright (c) 2024 Espressif Systems (Shanghai) Co., Ltd.
# SPDX-License-Identifier: Apache-2.0

config BOARD_ESP32S3_FAN_CONTROLLER
	select SOC_ESP32S3_WROOM_N16R8
	select SOC_ESP32S3_PROCPU if BOARD_ESP32S3_FAN_CONTROLLER_ESP32S3_PROCPU
```

## boards/espressif/esp32s3_fan_controller/board.yml
```yaml
board:
  name: esp32s3_fan_controller
  full_name: ESP32-S3 Fan Controller
  vendor: espressif
  socs:
  - name: esp32s3
```

## boards/espressif/esp32s3_n16r8/board.yml
```yaml
board:
  name: esp32s3_n16r8
  full_name: ESP32-S3 N16R8
  vendor: espressif
  socs:
  - name: esp32s3
```

## boards/others/stm32f103_ot_gateway/board.yml
```yaml
board:
  name: stm32f103_ot_gateway
  full_name: STM32F103 OT Gateway Board
  vendor: others
  socs:
    - name: stm32f103xb
```

## boards/others/stm32f103_ot_sensor/board.yml
```yaml
board:
  name: stm32f103_ot_sensor
  full_name: STM32F103 OT Sensor Board
  vendor: others
  socs:
    - name: stm32f103xb
```
